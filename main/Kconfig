## main/Kconfig
```kconfig
menu "models: custom_detect"
    config FLASH_ESPDET_PICO_imgH_imgW_CUSTOM
        bool "flash espdet_pico_imgH_imgW_custom"
        depends on !CAT_DETECT_MODEL_IN_SDCARD
        default y


    choice
        prompt "default"
        default ESPDET_PICO_imgH_imgW_CUSTOM
        help
            default custom_detect model
        config ESPDET_PICO_imgH_imgW_CUSTOM
            bool "espdet_pico_imgH_imgW_custom"
            depends on ESPDET_DETECT_MODEL_IN_SDCARD || FLASH_ESPDET_PICO_imgH_imgW_CUSTOM
    endchoice


    config DEFAULT_ESPDET_DETECT_MODEL
        int
        default 0 if ESPDET_PICO_imgH_imgW_CUSTOM

    choice
        prompt "model location"
        default ESPDET_DETECT_MODEL_IN_FLASH_RODATA
        help
            espdet_detect model location
        config ESPDET_DETECT_MODEL_IN_FLASH_RODATA
            bool "flash_rodata"
        config ESPDET_DETECT_MODEL_IN_FLASH_PARTITION
            bool "flash_partition"
        config ESPDET_DETECT_MODEL_IN_SDCARD
            bool "sdcard"

    endchoice

    config ESPDET_DETECT_MODEL_LOCATION
        int
        default 0 if ESPDET_DETECT_MODEL_IN_FLASH_RODATA
        default 1 if ESPDET_DETECT_MODEL_IN_FLASH_PARTITION
        default 2 if ESPDET_DETECT_MODEL_IN_SDCARD

    config ESPDET_DETECT_MODEL_SDCARD_DIR
        string "espdet_detect model sdcard dir"
        default "models/s3" if IDF_TARGET_ESP32S3
        default "models/p4" if IDF_TARGET_ESP32P4
        depends on ESPDET_DETECT_MODEL_IN_SDCARD
        help
            Directory of models relative to sdcard mount point.
endmenu

menu "Application Mode"

config FWR_FLIGHT_TEST
    bool "Manual FWR flight test (no vision)"
    default n
    help
        Build only flapping-wing manual control loop.

endmenu
```

## sdkconfig.defaults
```kconfig
CONFIG_IDF_TARGET="esp32p4"
CONFIG_IDF_EXPERIMENTAL_FEATURES=y

# CPU Performance (SAFE)
CONFIG_COMPILER_OPTIMIZATION_PERF=y
CONFIG_LOG_DEFAULT_LEVEL_INFO=y

# Flash
CONFIG_ESPTOOLPY_FLASHMODE_QIO=y
CONFIG_ESPTOOLPY_FLASHSIZE_16MB=y

# WDT off (optional)
CONFIG_ESP_TASK_WDT_EN=n

CONFIG_SPIRAM_ALLOW_BSS_SEG_EXTERNAL_MEMORY=y
CONFIG_SPIRAM_USE_MALLOC=y
CONFIG_SPIRAM_MALLOC_ALWAYSINTERNAL=0
```
